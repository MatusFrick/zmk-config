## config/boards/shields/lebeda/Kconfig.defconfig
```kconfig
if SHIELD_LEBEDA_LEFT

config ZMK_KEYBOARD_NAME
	default "The LeBeDa"

config ZMK_SPLIT_BLE_ROLE_CENTRAL
	default y

endif

if SHIELD_LEBEDA_LEFT || SHIELD_LEBEDA_RIGHT

config ZMK_SPLIT
	default y

endif
```

## config/boards/shields/lebeda/Kconfig.shield
```kconfig
config SHIELD_LEBEDA_LEFT
    def_bool $(shields_list_contains,lebeda_left)

config SHIELD_LEBEDA_RIGHT
    def_bool $(shields_list_contains,lebeda_right)
```
